## build/Kconfig/arch/Kconfig
```kconfig
# Load Zephyr Arch Kconfig descriptions.
osource "/var/lib/jenkins/workspace/zephyrproject/zephyr/arch/rx/Kconfig"
osource "/var/lib/jenkins/workspace/zephyrproject/zephyr/arch/x86/Kconfig"
osource "/var/lib/jenkins/workspace/zephyrproject/zephyr/arch/xtensa/Kconfig"
osource "/var/lib/jenkins/workspace/zephyrproject/zephyr/arch/sparc/Kconfig"
osource "/var/lib/jenkins/workspace/zephyrproject/zephyr/arch/riscv/Kconfig"
osource "/var/lib/jenkins/workspace/zephyrproject/zephyr/arch/posix/Kconfig"
osource "/var/lib/jenkins/workspace/zephyrproject/zephyr/arch/mips/Kconfig"
osource "/var/lib/jenkins/workspace/zephyrproject/zephyr/arch/arm64/Kconfig"
osource "/var/lib/jenkins/workspace/zephyrproject/zephyr/arch/arm/Kconfig"
osource "/var/lib/jenkins/workspace/zephyrproject/zephyr/arch/arc/Kconfig"
```

## build/Kconfig/boards/Kconfig.defconfig
```kconfig
# Load Zephyr board defconfig descriptions.
osource "/var/lib/jenkins/workspace/zephyrproject/zephyr/boards/native/native_sim/Kconfig.defconfig"
```

## build/Kconfig/boards/Kconfig.native_sim
```kconfig
# Load board Kconfig descriptions.
osource "/var/lib/jenkins/workspace/zephyrproject/zephyr/boards/native/native_sim/Kconfig.native_sim"
```

## build/Kconfig/boards/Kconfig.sysbuild
```kconfig
# Load Sysbuild board Kconfig descriptions.
osource "/var/lib/jenkins/workspace/zephyrproject/zephyr/boards/native/native_sim/Kconfig.sysbuild"
```

## build/Kconfig/soc/Kconfig
```kconfig
# Load Zephyr SoC Kconfig descriptions.
osource "/var/lib/jenkins/workspace/zephyrproject/zephyr/soc/xlnx/zynqmp/Kconfig"
osource "/var/lib/jenkins/workspace/zephyrproject/zephyr/soc/xlnx/zynq7000/Kconfig"
osource "/var/lib/jenkins/workspace/zephyrproject/zephyr/soc/xlnx/versalnet/Kconfig"
osource "/var/lib/jenkins/workspace/zephyrproject/zephyr/soc/xlnx/versal2/Kconfig"
osource "/var/lib/jenkins/workspace/zephyrproject/zephyr/soc/xen/Kconfig"
osource "/var/lib/jenkins/workspace/zephyrproject/zephyr/soc/wch/ch32v/Kconfig"
osource "/var/lib/jenkins/workspace/zephyrproject/zephyr/soc/ti/simplelink/Kconfig"
osource "/var/lib/jenkins/workspace/zephyrproject/zephyr/soc/ti/mspm0/Kconfig"
osource "/var/lib/jenkins/workspace/zephyrproject/zephyr/soc/ti/lm3s6965/Kconfig"
osource "/var/lib/jenkins/workspace/zephyrproject/zephyr/soc/ti/k3/Kconfig"
osource "/var/lib/jenkins/workspace/zephyrproject/zephyr/soc/telink/tlsr/Kconfig"
osource "/var/lib/jenkins/workspace/zephyrproject/zephyr/soc/starfive/jh71xx/Kconfig"
osource "/var/lib/jenkins/workspace/zephyrproject/zephyr/soc/st/stm32/Kconfig"
osource "/var/lib/jenkins/workspace/zephyrproject/zephyr/soc/snps/qemu_arc/Kconfig"
osource "/var/lib/jenkins/workspace/zephyrproject/zephyr/soc/snps/nsim/arc_v/Kconfig"
osource "/var/lib/jenkins/workspace/zephyrproject/zephyr/soc/snps/nsim/arc_classic/Kconfig"
osource "/var/lib/jenkins/workspace/zephyrproject/zephyr/soc/snps/hsdk4xd/Kconfig"
osource "/var/lib/jenkins/workspace/zephyrproject/zephyr/soc/snps/hsdk/Kconfig"
osource "/var/lib/jenkins/workspace/zephyrproject/zephyr/soc/snps/emsk/Kconfig"
osource "/var/lib/jenkins/workspace/zephyrproject/zephyr/soc/snps/emsdp/Kconfig"
osource "/var/lib/jenkins/workspace/zephyrproject/zephyr/soc/snps/arc_iot/Kconfig"
osource "/var/lib/jenkins/workspace/zephyrproject/zephyr/soc/silabs/Kconfig"
osource "/var/lib/jenkins/workspace/zephyrproject/zephyr/soc/sifive/sifive_freedom/Kconfig"
osource "/var/lib/jenkins/workspace/zephyrproject/zephyr/soc/sensry/Kconfig"
osource "/var/lib/jenkins/workspace/zephyrproject/zephyr/soc/rockchip/Kconfig"
osource "/var/lib/jenkins/workspace/zephyrproject/zephyr/soc/renode/riscv_virtual/Kconfig"
osource "/var/lib/jenkins/workspace/zephyrproject/zephyr/soc/renode/cortex_r8_virtual/Kconfig"
osource "/var/lib/jenkins/workspace/zephyrproject/zephyr/soc/renesas/smartbond/Kconfig"
osource "/var/lib/jenkins/workspace/zephyrproject/zephyr/soc/renesas/rz/Kconfig"
osource "/var/lib/jenkins/workspace/zephyrproject/zephyr/soc/renesas/rx/Kconfig"
osource "/var/lib/jenkins/workspace/zephyrproject/zephyr/soc/renesas/rcar/Kconfig"
osource "/var/lib/jenkins/workspace/zephyrproject/zephyr/soc/renesas/ra/Kconfig"
osource "/var/lib/jenkins/workspace/zephyrproject/zephyr/soc/realtek/ec/Kconfig"
osource "/var/lib/jenkins/workspace/zephyrproject/zephyr/soc/raspberrypi/rpi_pico/Kconfig"
osource "/var/lib/jenkins/workspace/zephyrproject/zephyr/soc/quicklogic/eos_s3/Kconfig"
osource "/var/lib/jenkins/workspace/zephyrproject/zephyr/soc/qemu/virt_riscv/Kconfig"
osource "/var/lib/jenkins/workspace/zephyrproject/zephyr/soc/qemu/malta/Kconfig"
osource "/var/lib/jenkins/workspace/zephyrproject/zephyr/soc/openisa/rv32m1/Kconfig"
osource "/var/lib/jenkins/workspace/zephyrproject/zephyr/soc/openhwgroup/cva6/Kconfig"
osource "/var/lib/jenkins/workspace/zephyrproject/zephyr/soc/oct/osd32mp15x/Kconfig"
osource "/var/lib/jenkins/workspace/zephyrproject/zephyr/soc/nxp/s32/Kconfig"
osource "/var/lib/jenkins/workspace/zephyrproject/zephyr/soc/nxp/rw/Kconfig"
osource "/var/lib/jenkins/workspace/zephyrproject/zephyr/soc/nxp/mcx/Kconfig"
osource "/var/lib/jenkins/workspace/zephyrproject/zephyr/soc/nxp/lpc/Kconfig"
osource "/var/lib/jenkins/workspace/zephyrproject/zephyr/soc/nxp/layerscape/Kconfig"
osource "/var/lib/jenkins/workspace/zephyrproject/zephyr/soc/nxp/kinetis/Kconfig"
osource "/var/lib/jenkins/workspace/zephyrproject/zephyr/soc/nxp/imxrt/Kconfig"
osource "/var/lib/jenkins/workspace/zephyrproject/zephyr/soc/nxp/imx/Kconfig"
osource "/var/lib/jenkins/workspace/zephyrproject/zephyr/soc/nuvoton/numicro/Kconfig"
osource "/var/lib/jenkins/workspace/zephyrproject/zephyr/soc/nuvoton/numaker/Kconfig"
osource "/var/lib/jenkins/workspace/zephyrproject/zephyr/soc/nuvoton/npcx/Kconfig"
osource "/var/lib/jenkins/workspace/zephyrproject/zephyr/soc/nuvoton/npcm/Kconfig"
osource "/var/lib/jenkins/workspace/zephyrproject/zephyr/soc/nordic/Kconfig"
osource "/var/lib/jenkins/workspace/zephyrproject/zephyr/soc/neorv32/Kconfig"
osource "/var/lib/jenkins/workspace/zephyrproject/zephyr/soc/native/inf_clock/Kconfig"
osource "/var/lib/jenkins/workspace/zephyrproject/zephyr/soc/microchip/sam/Kconfig"
osource "/var/lib/jenkins/workspace/zephyrproject/zephyr/soc/microchip/miv/Kconfig"
osource "/var/lib/jenkins/workspace/zephyrproject/zephyr/soc/microchip/mec/Kconfig"
osource "/var/lib/jenkins/workspace/zephyrproject/zephyr/soc/mediatek/mt8xxx/Kconfig"
osource "/var/lib/jenkins/workspace/zephyrproject/zephyr/soc/lowrisc/opentitan/Kconfig"
osource "/var/lib/jenkins/workspace/zephyrproject/zephyr/soc/litex/litex_vexriscv/Kconfig"
osource "/var/lib/jenkins/workspace/zephyrproject/zephyr/soc/ite/ec/Kconfig"
osource "/var/lib/jenkins/workspace/zephyrproject/zephyr/soc/intel/raptor_lake/Kconfig"
osource "/var/lib/jenkins/workspace/zephyrproject/zephyr/soc/intel/lakemont/Kconfig"
osource "/var/lib/jenkins/workspace/zephyrproject/zephyr/soc/intel/intel_socfpga_std/Kconfig"
osource "/var/lib/jenkins/workspace/zephyrproject/zephyr/soc/intel/intel_socfpga/Kconfig"
osource "/var/lib/jenkins/workspace/zephyrproject/zephyr/soc/intel/intel_niosv/Kconfig"
osource "/var/lib/jenkins/workspace/zephyrproject/zephyr/soc/intel/intel_ish/Kconfig"
osource "/var/lib/jenkins/workspace/zephyrproject/zephyr/soc/intel/intel_adsp/Kconfig"
osource "/var/lib/jenkins/workspace/zephyrproject/zephyr/soc/intel/elkhart_lake/Kconfig"
osource "/var/lib/jenkins/workspace/zephyrproject/zephyr/soc/intel/atom/Kconfig"
osource "/var/lib/jenkins/workspace/zephyrproject/zephyr/soc/intel/apollo_lake/Kconfig"
osource "/var/lib/jenkins/workspace/zephyrproject/zephyr/soc/intel/alder_lake/Kconfig"
osource "/var/lib/jenkins/workspace/zephyrproject/zephyr/soc/infineon/cat3/Kconfig"
osource "/var/lib/jenkins/workspace/zephyrproject/zephyr/soc/infineon/cat1c/Kconfig"
osource "/var/lib/jenkins/workspace/zephyrproject/zephyr/soc/infineon/cat1b/Kconfig"
osource "/var/lib/jenkins/workspace/zephyrproject/zephyr/soc/infineon/cat1a/Kconfig"
osource "/var/lib/jenkins/workspace/zephyrproject/zephyr/soc/gd/gd32/Kconfig"
osource "/var/lib/jenkins/workspace/zephyrproject/zephyr/soc/gaisler/leon3/Kconfig"
osource "/var/lib/jenkins/workspace/zephyrproject/zephyr/soc/gaisler/gr716a/Kconfig"
osource "/var/lib/jenkins/workspace/zephyrproject/zephyr/soc/espressif/Kconfig"
osource "/var/lib/jenkins/workspace/zephyrproject/zephyr/soc/ene/kb1200/Kconfig"
osource "/var/lib/jenkins/workspace/zephyrproject/zephyr/soc/ene/kb106x/Kconfig"
osource "/var/lib/jenkins/workspace/zephyrproject/zephyr/soc/efinix/sapphire/Kconfig"
osource "/var/lib/jenkins/workspace/zephyrproject/zephyr/soc/cdns/xtensa_sample_controller/Kconfig"
osource "/var/lib/jenkins/workspace/zephyrproject/zephyr/soc/cdns/sample_controller32/Kconfig"
osource "/var/lib/jenkins/workspace/zephyrproject/zephyr/soc/cdns/dc233c/Kconfig"
osource "/var/lib/jenkins/workspace/zephyrproject/zephyr/soc/brcm/bcmvk/Kconfig"
osource "/var/lib/jenkins/workspace/zephyrproject/zephyr/soc/brcm/bcm2712/Kconfig"
osource "/var/lib/jenkins/workspace/zephyrproject/zephyr/soc/brcm/bcm2711/Kconfig"
osource "/var/lib/jenkins/workspace/zephyrproject/zephyr/soc/bflb/Kconfig"
osource "/var/lib/jenkins/workspace/zephyrproject/zephyr/soc/atmel/sam0/Kconfig"
osource "/var/lib/jenkins/workspace/zephyrproject/zephyr/soc/atmel/sam/Kconfig"
osource "/var/lib/jenkins/workspace/zephyrproject/zephyr/soc/aspeed/Kconfig"
osource "/var/lib/jenkins/workspace/zephyrproject/zephyr/soc/arm/Kconfig"
osource "/var/lib/jenkins/workspace/zephyrproject/zephyr/soc/arm/beetle/Kconfig"
osource "/var/lib/jenkins/workspace/zephyrproject/zephyr/soc/antmicro/myra/Kconfig"
osource "/var/lib/jenkins/workspace/zephyrproject/zephyr/soc/andestech/Kconfig"
osource "/var/lib/jenkins/workspace/zephyrproject/zephyr/soc/amd/acp_6_0/Kconfig"
osource "/var/lib/jenkins/workspace/zephyrproject/zephyr/soc/ambiq/Kconfig"
osource "/var/lib/jenkins/workspace/zephyrproject/zephyr/soc/aesc/Kconfig"
osource "/var/lib/jenkins/workspace/zephyrproject/zephyr/soc/adi/max32/Kconfig"
```
